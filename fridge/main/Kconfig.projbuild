## fridge/main/Kconfig.projbuild
```kconfig
menu "fridge"

config WIFI_SSID
    string "WIFI SSID"

config WIFI_PWD
    string "WIFI password"

config MQTT_BROKER_URL
    string "MQTT broker URL"

endmenu
```
